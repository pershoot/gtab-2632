## drivers/net/wireless/bcm4329/Kconfig
```kconfig
config BCM4329
	tristate "Broadcom 4329 wireless cards support"
	depends on WIRELESS_EXT && MMC
	---help---
	  This module adds support for wireless adapters based on
	  Broadcom 4329 chipset.

	  This driver uses the kernel's wireless extensions subsystem.

	  If you choose to build a module, it'll be called dhd. Say M if
	  unsure.

config BCM4329_FW_PATH
	depends on BCM4329
	string "Firmware path"
	default "/system/lib/hw/wlan/fw_bcm4329.bin"
	---help---
	  Path to the firmware file.

config BCM4329_NVRAM_PATH
	depends on BCM4329
	string "NVRAM path"
	default "/system/lib/hw/wlan/nvram.txt"
	---help---
	  Path to the calibration file.

config BCM4329_ENABLE_CSCAN
        depends on BCM4329
        bool "Enable CSCAN"
        default n
        ---help---
          Enable the use of CSCAN methods.

config BCM4329_ENABLE_PNO_SUPPORT
        depends on BCM4329_ENABLE_CSCAN
        bool "Enable PNO_SUPPORT"
        default n
        ---help---
          Enable the use of PNO_SUPPORT methods.
```
